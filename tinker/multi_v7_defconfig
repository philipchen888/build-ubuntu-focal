## tinker/multi_v7_defconfig
```kconfig
CONFIG_BT_HCIUART_RTL=y
CONFIG_BT_HCIUART_3WIRE=y
CONFIG_BT_HCIUART_SERDEV=y
CONFIG_SERIAL_DEV_CTRL_TTYPORT=y
CONFIG_RTL8723BS=y
CONFIG_DRM_DW_HDMI_CEC=y
CONFIG_DRM_DW_HDMI_I2S_AUDIO=y
```
